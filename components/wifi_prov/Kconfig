## components/wifi_prov/Kconfig
```kconfig
menu "Wi-Fi Manager Configuration"

config WIFI_CONN_RETRY_MAX
    int "Maximum Wi-Fi connection retry attempts"
    default 5
    range 1 20
    help
        The number of times the system should try to reconnect to Wi-Fi
        before giving up or switching to another method (e.g. provisioning).

endmenu
```

## sdkconfig.defaults
```kconfig
# --- Partition Table ---
CONFIG_PARTITION_TABLE_CUSTOM=y
CONFIG_PARTITION_TABLE_CUSTOM_FILENAME="partitions.csv"

# --- Flashing ---
CONFIG_ESPTOOLPY_FLASHMODE_DIO=y
CONFIG_ESPTOOLPY_FLASHFREQ_40M=y
CONFIG_ESPTOOLPY_FLASHSIZE_4MB=y

# --- Console UART ---
CONFIG_ESP_CONSOLE_UART_BAUDRATE=115200
```
